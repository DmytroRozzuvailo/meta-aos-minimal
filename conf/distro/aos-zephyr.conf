## conf/distro/aos-zephyr.conf
```bitbake
include conf/distro/poky.conf

DISTRO = "aos-zephyr"
DISTRO_NAME = "Zephyr AOS"
DISTRO_VERSION = "1.0"
SDK_VENDOR = "-aossdk"
SDK_VERSION="${DISTRO_VERSION}"

TARGET_VENDOR = "-aoszephyr"

DISTROOVERRIDES = "aoszephyr"

# Add systemd configuration
DISTRO_FEATURES_append = " systemd"
DISTRO_FEATURES_BACKFILL_CONSIDERED += "sysvinit"
VIRTUAL-RUNTIME_init_manager = "systemd"
VIRTUAL-RUNTIME_initscripts = "systemd-compat-units"

# Initramfs configuration
INITRAMFS_IMAGE = "core-image-tiny-initramfs"
INITRAMFS_IMAGE_BUNDLE = "0"
INITRAMFS_FSTYPES = "cpio.gz"
```
